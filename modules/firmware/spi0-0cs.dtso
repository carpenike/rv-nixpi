/dts-v1/;

/ {
	compatible = "raspberrypi";
	#address-cells = <1>;  // Explicitly define address-cells in the root node
	#size-cells = <0>;  // Explicitly define size-cells in the root node

	gpio: gpio {
		compatible = "brcm,bcm2835-gpio";
		#gpio-cells = <2>;
		gpio-controller;
		interrupt-controller;  // Add interrupt-controller property.
		#interrupt-cells = <2>;  // Define interrupt-cells for GPIO interrupts.
	};

	spi0: spi {
		compatible = "brcm,bcm2835-spi";
		interrupts = <2 22>;
		#address-cells = <1>;
		#size-cells = <0>;
		interrupt-parent = <&gpio>;
		status = "okay";
	};

	fragment@0 {
		target = <&spi0>;

		__overlay__ {
			#address-cells = <1>;
			#size-cells = <0>;
			cs-gpios = <&gpio 8 1>, <&gpio 7 1>;  // GPIO 8 for CS0, GPIO 7 for CS1.
			status = "okay";

			mcp2515@0 {
				compatible = "microchip,mcp2515";
				reg = <0>;  // Chipselect 0.
				spi-max-frequency = <10000000>;  // 10 MHz.
					interrupt-parent = <&gpio>;
				interrupts = <25 2>;  // GPIO 25, Falling edge triggered.
				oscillator-frequency = <16000000>;
			};
		};
	};

	fragment@1 {
		target = <0xffffffff>;

		__overlay__ {
			cs-gpios;
			status = "okay";
		};
	};

	fragment@2 {
		target = <0xffffffff>;

		__overlay__ {
			status = "disabled";
		};
	};

	fragment@3 {
		target = <0xffffffff>;

		__dormant__ {
			brcm,pins = <0x0a 0x0b>;
		};
	};

	__overrides__ {
		no_miso = [00 00 00 00 3d 33 00];
	};

	__symbols__ {
		frag0 = "/fragment@0/__overlay__";
	};

	__fixups__ {
		spidev0 = "/fragment@2:target:0";
	};
};
